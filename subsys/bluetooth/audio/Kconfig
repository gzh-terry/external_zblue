## subsys/bluetooth/audio/Kconfig
```kconfig
# Bluetooth Audio configuration options

#
# Copyright (c) 2020 Intel Corporation
# Copyright (c) 2022 Nordic Semiconductor ASA
#
# SPDX-License-Identifier: Apache-2.0
#

menuconfig BT_AUDIO
	bool "Bluetooth Audio support [EXPERIMENTAL]"
	select EXPERIMENTAL
	help
	  This option enables Bluetooth Audio support. The specific
	  features that are available may depend on other features
	  that have been enabled in the stack, such as Periodic
	  Advertisement for Broadcast and L2CAP Dynamic Channel
	  for Unicast.

if BT_AUDIO

config BT_CCID
	bool
	help
	  This hidden option is enabled when any of the content control
	  features are enabled.

source "$APPSDIR/external/zblue/subsys/bluetooth/audio/Kconfig.baps"
source "$APPSDIR/external/zblue/subsys/bluetooth/audio/Kconfig.vocs"
source "$APPSDIR/external/zblue/subsys/bluetooth/audio/Kconfig.aics"
source "$APPSDIR/external/zblue/subsys/bluetooth/audio/Kconfig.vcs"
source "$APPSDIR/external/zblue/subsys/bluetooth/audio/Kconfig.mics"
source "$APPSDIR/external/zblue/subsys/bluetooth/audio/Kconfig.csis"
source "$APPSDIR/external/zblue/subsys/bluetooth/audio/Kconfig.mcs"

endif # BT_AUDIO
```

## subsys/bluetooth/services/Kconfig
```kconfig
# GATT Services

# Copyright (c) 2018 Nordic Semiconductor ASA
# SPDX-License-Identifier: Apache-2.0

menu "GATT Services"
	depends on BT_CONN

source "$APPSDIR/external/zblue/zblue/subsys/bluetooth/services/Kconfig.dis"

source "$APPSDIR/external/zblue/zblue/subsys/bluetooth/services/Kconfig.bas"

source "$APPSDIR/external/zblue/zblue/subsys/bluetooth/services/Kconfig.hrs"

source "$APPSDIR/external/zblue/zblue/subsys/bluetooth/services/ots/Kconfig"

source "$APPSDIR/external/zblue/zblue/subsys/bluetooth/services/Kconfig.ias"

source "$APPSDIR/external/zblue/zblue/subsys/bluetooth/services/ots/Kconfig"

endmenu
```

## subsys/bluetooth/services/Kconfig.bas
```kconfig
# Bluetooth GATT Battery service

# Copyright (c) 2018 Nordic Semiconductor ASA
# SPDX-License-Identifier: Apache-2.0

menuconfig BT_BAS
	bool "GATT Battery service"
	select SENSOR
```

## subsys/bluetooth/services/Kconfig.tps
```kconfig
# Bluetooth GATT TX Power Service

# Copyright (c) 2020 Nordic Semiconductor ASA
# SPDX-License-Identifier: Apache-2.0

menuconfig BT_TPS
	bool "Enable GATT TX Power service"
```
